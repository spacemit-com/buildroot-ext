## configs/spacemit_k1_plt_defconfig
```kconfig
BR2_riscv=y
BR2_riscv_custom=y
BR2_RISCV_ISA_CUSTOM_RVM=y
BR2_RISCV_ISA_CUSTOM_RVF=y
BR2_RISCV_ISA_CUSTOM_RVD=y
BR2_RISCV_ISA_CUSTOM_RVC=y
BR2_TOOLCHAIN_EXTERNAL=y
BR2_TOOLCHAIN_EXTERNAL_CUSTOM=y
BR2_TOOLCHAIN_EXTERNAL_DOWNLOAD=y
BR2_TOOLCHAIN_EXTERNAL_URL="http://archive.spacemit.com/toolchain/spacemit-toolchain-linux-glibc-x86_64-v1.0.0.tar.xz"
BR2_TOOLCHAIN_EXTERNAL_REL_BIN_PATH="spacemit-toolchain-linux-glibc-x86_64-v1.0.0/bin"
BR2_TOOLCHAIN_EXTERNAL_CUSTOM_PREFIX="$(ARCH)-unknown-linux-gnu"
BR2_TOOLCHAIN_EXTERNAL_HEADERS_6_1=y
BR2_TOOLCHAIN_EXTERNAL_CUSTOM_GLIBC=y
# BR2_TOOLCHAIN_EXTERNAL_INET_RPC is not set
BR2_TOOLCHAIN_EXTERNAL_CXX=y
BR2_TOOLCHAIN_EXTERNAL_FORTRAN=y
BR2_TOOLCHAIN_EXTERNAL_OPENMP=y
BR2_PRIMARY_SITE="http://archive.spacemit.com/buildroot/dl"
BR2_CCACHE=y
BR2_PACKAGE_OVERRIDE_FILE="$(TOPDIR)/../buildroot-ext/local.mk"
BR2_GLOBAL_PATCH_DIR="$(TOPDIR)/../buildroot-ext/patches/"
BR2_TARGET_GENERIC_HOSTNAME="Bianbu"
BR2_TARGET_GENERIC_ISSUE="Welcome to Bianbu Linux"
BR2_ROOTFS_DEVICE_CREATION_DYNAMIC_EUDEV=y
BR2_TARGET_GENERIC_ROOT_PASSWD="bianbu"
# BR2_ENABLE_LOCALE_PURGE is not set
BR2_GENERATE_LOCALE="C en_US.UTF-8 zh_CN.UTF-8"
BR2_ROOTFS_OVERLAY="$(BR2_EXTERNAL_Bianbu_PATH)/board/spacemit/k1/target_overlay"
BR2_ROOTFS_POST_BUILD_SCRIPT="$(BR2_EXTERNAL_Bianbu_PATH)/board/spacemit/k1/plt_custom.sh"
BR2_ROOTFS_POST_IMAGE_SCRIPT="$(BR2_EXTERNAL_Bianbu_PATH)/board/spacemit/k1/prepare_img.sh"
BR2_LINUX_KERNEL=y
BR2_LINUX_KERNEL_CUSTOM_DIR=y
BR2_LINUX_KERNEL_CUSTOM_DIR_LOCATION="$(TOPDIR)/../bsp-src/linux-6.1"
BR2_LINUX_KERNEL_USE_CUSTOM_CONFIG=y
BR2_LINUX_KERNEL_CUSTOM_CONFIG_FILE="$(LINUX_OVERRIDE_SRCDIR)/arch/riscv/configs/k1_defconfig"
BR2_LINUX_KERNEL_IMAGE_TARGET_CUSTOM=y
BR2_LINUX_KERNEL_IMAGE_TARGET_NAME="Image.itb"
BR2_LINUX_KERNEL_IMAGE_NAME="Image.itb"
BR2_LINUX_KERNEL_DTS_SUPPORT=y
BR2_LINUX_KERNEL_INTREE_DTS_NAME="k1-x_deb1 k1-x_MINI-PC k1-x_MUSE-Pi spacemit/k1-x_kx312 spacemit/k1-x_MUSE-Book"
BR2_LINUX_KERNEL_CUSTOM_DTS_PATH="$(BR2_EXTERNAL_Bianbu_PATH)/board/spacemit/k1/plt_dts/kernel/k1-x_deb1.dts $(BR2_EXTERNAL_Bianbu_PATH)/board/spacemit/k1/plt_dts/kernel/k1-x_MINI-PC.dts $(BR2_EXTERNAL_Bianbu_PATH)/board/spacemit/k1/plt_dts/kernel/k1-x_MUSE-Pi.dts"
BR2_PACKAGE_LINUX_TOOLS_GPIO=y
BR2_PACKAGE_BUSYBOX_SHOW_OTHERS=y
BR2_PACKAGE_ALSA_UTILS=y
BR2_PACKAGE_ALSA_UTILS_AMIXER=y
BR2_PACKAGE_ALSA_UTILS_APLAY=y
BR2_PACKAGE_ALSA_UTILS_APLAYMIDI=y
BR2_PACKAGE_GSTREAMER1=y
BR2_PACKAGE_GST1_PLUGINS_BASE_PLUGIN_VIDEOTESTSRC=y
BR2_PACKAGE_GST1_PLUGINS_GOOD=y
BR2_PACKAGE_GST1_PLUGINS_GOOD_PLUGIN_AUTODETECT=y
BR2_PACKAGE_GST1_PLUGINS_GOOD_PLUGIN_DEINTERLACE=y
BR2_PACKAGE_GST1_PLUGINS_GOOD_PLUGIN_V4L2=y
BR2_PACKAGE_GST1_PLUGINS_BAD=y
BR2_PACKAGE_GST1_PLUGINS_BAD_PLUGIN_VIDEOPARSERS=y
BR2_PACKAGE_GST1_PYTHON=y
BR2_PACKAGE_STRESS_NG=y
BR2_PACKAGE_E2FSPROGS=y
BR2_PACKAGE_E2FSPROGS_RESIZE2FS=y
BR2_PACKAGE_EXFAT_UTILS=y
BR2_PACKAGE_EXFATPROGS=y
BR2_PACKAGE_NTFS_3G=y
BR2_PACKAGE_NTFS_3G_NTFSPROGS=y
BR2_PACKAGE_LIBERATION=y
BR2_PACKAGE_WQY_ZENHEI=y
BR2_PACKAGE_GLMARK2=y
BR2_PACKAGE_SDL2=y
BR2_PACKAGE_QT5=y
BR2_PACKAGE_QT5BASE_SQLITE_QT=y
BR2_PACKAGE_QT5BASE_OPENGL=y
BR2_PACKAGE_QT5BASE_FONTCONFIG=y
BR2_PACKAGE_QT5BASE_SYSLOG=y
BR2_PACKAGE_QT5MULTIMEDIA=y
BR2_PACKAGE_QT5WAYLAND=y
BR2_PACKAGE_WESTON=y
BR2_PACKAGE_EDID_DECODE=y
BR2_PACKAGE_MEMTESTER=y
BR2_PACKAGE_PYTHON3=y
BR2_PACKAGE_PYTHON_ALSAAUDIO=y
BR2_PACKAGE_PYTHON_DNSPYTHON=y
BR2_PACKAGE_PYTHON_LIBEVDEV=y
BR2_PACKAGE_PYTHON_NUMPY=y
BR2_PACKAGE_PYTHON_PILLOW=y
BR2_PACKAGE_PYTHON_PIP=y
BR2_PACKAGE_PYTHON_PYQT5=y
BR2_PACKAGE_PYTHON_QRCODE=y
BR2_PACKAGE_PYTHON_SERIAL=y
BR2_PACKAGE_LIBOPENSSL_BIN=y
BR2_PACKAGE_LIBOPENSSL_ENGINES=y
BR2_PACKAGE_JASPER=y
BR2_PACKAGE_LIBDRM_INSTALL_TESTS=y
BR2_PACKAGE_UTF8PROC=y
BR2_PACKAGE_HAVEGED=y
BR2_PACKAGE_BLUEZ_TOOLS=y
BR2_PACKAGE_BLUEZ5_UTILS=y
BR2_PACKAGE_BLUEZ5_UTILS_OBEX=y
BR2_PACKAGE_BLUEZ5_UTILS_CLIENT=y
BR2_PACKAGE_BLUEZ5_UTILS_MONITOR=y
BR2_PACKAGE_BLUEZ5_UTILS_DEPRECATED=y
BR2_PACKAGE_BLUEZ5_UTILS_PLUGINS_AUDIO=y
# BR2_PACKAGE_BLUEZ5_UTILS_PLUGINS_NETWORK is not set
BR2_PACKAGE_BLUEZ5_UTILS_TOOLS_HID2HCI=y
BR2_PACKAGE_DHCPCD=y
BR2_PACKAGE_IPERF3=y
BR2_PACKAGE_MODEM_MANAGER=y
BR2_PACKAGE_NTP=y
BR2_PACKAGE_OPENSSH=y
BR2_PACKAGE_WPA_SUPPLICANT=y
BR2_PACKAGE_WPA_SUPPLICANT_CLI=y
# BR2_PACKAGE_URANDOM_SCRIPTS is not set
BR2_PACKAGE_BASH=y
BR2_PACKAGE_ANDROID_TOOLS=y
BR2_PACKAGE_ANDROID_TOOLS_ADB=y
BR2_PACKAGE_ANDROID_TOOLS_ADBD=y
BR2_PACKAGE_SYSLOG_NG=y
BR2_PACKAGE_UTIL_LINUX_IRQTOP=y
BR2_PACKAGE_UTIL_LINUX_KILL=y
BR2_PACKAGE_UTIL_LINUX_MORE=y
BR2_PACKAGE_UTIL_LINUX_MOUNT=y
BR2_PACKAGE_NANO=y
BR2_PACKAGE_VIM=y
BR2_TARGET_ROOTFS_CPIO=y
BR2_TARGET_ROOTFS_CPIO_DRACUT=y
BR2_TARGET_ROOTFS_CPIO_DRACUT_MODULES="$(BR2_EXTERNAL_Bianbu_PATH)/board/spacemit/k1/dracut-modules"
BR2_TARGET_ROOTFS_CPIO_DRACUT_CONF_FILES="$(BR2_EXTERNAL_Bianbu_PATH)/board/spacemit/k1/dracut.conf"
BR2_TARGET_ROOTFS_CPIO_GZIP=y
BR2_TARGET_ROOTFS_EXT2=y
BR2_TARGET_ROOTFS_EXT2_4=y
BR2_TARGET_ROOTFS_EXT2_SIZE="512M"
# BR2_TARGET_ROOTFS_TAR is not set
BR2_TARGET_OPENSBI=y
BR2_TARGET_OPENSBI_PLAT="generic"
# BR2_TARGET_OPENSBI_INSTALL_JUMP_IMG is not set
BR2_TARGET_OPENSBI_ADDITIONAL_VARIABLES="PLATFORM_DEFCONFIG=k1_defconfig"
BR2_TARGET_UBOOT=y
BR2_TARGET_UBOOT_USE_CUSTOM_CONFIG=y
BR2_TARGET_UBOOT_CUSTOM_CONFIG_FILE="$(UBOOT_OVERRIDE_SRCDIR)/configs/k1_defconfig"
# BR2_TARGET_UBOOT_FORMAT_BIN is not set
BR2_TARGET_UBOOT_FORMAT_CUSTOM=y
BR2_TARGET_UBOOT_FORMAT_CUSTOM_NAME="u-boot.itb u-boot-env-default.bin"
BR2_TARGET_UBOOT_SPL=y
BR2_TARGET_UBOOT_SPL_NAME="FSBL.bin bootinfo_*.bin"
BR2_TARGET_UBOOT_CUSTOM_DTS_PATH="$(BR2_EXTERNAL_Bianbu_PATH)/board/spacemit/k1/plt_dts/u-boot/k1-x_deb1.dts $(BR2_EXTERNAL_Bianbu_PATH)/board/spacemit/k1/plt_dts/u-boot/k1-x_MINI-PC.dts $(BR2_EXTERNAL_Bianbu_PATH)/board/spacemit/k1/plt_dts/u-boot/k1-x_kx312.dts $(BR2_EXTERNAL_Bianbu_PATH)/board/spacemit/k1/plt_dts/u-boot/k1-x_MUSE-Book.dts $(BR2_EXTERNAL_Bianbu_PATH)/board/spacemit/k1/plt_dts/u-boot/k1-x_MUSE-Pi.dts"
BR2_PACKAGE_HOST_GENIMAGE=y
BR2_PACKAGE_HOST_JQ=y
BR2_PACKAGE_HOST_PYTHON_PYYAML=y
BR2_PACKAGE_HOST_PYTHON3=y
BR2_PACKAGE_RTK_HCIATTACH=y
BR2_PACKAGE_MPP=y
BR2_PACKAGE_IMG_GPU_POWERVR=y
BR2_PACKAGE_IMG_GPU_POWERVR_OUTPUT_WL=y
BR2_PACKAGE_DRM_TEST=y
BR2_PACKAGE_K1X_VPU_TEST=y
BR2_PACKAGE_K1X_VPU_FIRMWARE=y
BR2_PACKAGE_K1X_JPU=y
BR2_PACKAGE_FACTORYTEST=y
```

## package/ai-support/Config.in
```kconfig
config BR2_PACKAGE_AI_SUPPORT
	bool "k1 ai support"
	default n
	select BR2_PACKAGE_ONNX_RUNTIME
	select BR2_PACKAGE_OPENCV4
	select BR2_PACKAGE_OPENCV4_LIB_IMGPROC
	help
	  Spacemit k1 AI support lib.

if BR2_PACKAGE_AI_SUPPORT

config BR2_PACKAGE_AI_SUPPORT_DEMO
	bool "k1 ai support demo"
	default y
	select BR2_PACKAGE_OPENCV4_LIB_HIGHGUI
	select BR2_PACKAGE_OPENCV4_LIB_IMGCODECS
	select BR2_PACKAGE_OPENCV4_LIB_VIDEOIO
	help
	  Spacemit k1 AI support demo.

endif
```

## package/drm-test/Config.in
```kconfig
comment "drm test package"

config BR2_PACKAGE_DRM_TEST
	bool "drm-test"
	depends on BR2_PACKAGE_LIBDRM
	help
	  Utility for testing drm working on variable modes.

	  https://github.com/dvdhrm/docs.git
```

## package/factorytest/Config.in
```kconfig
config BR2_PACKAGE_FACTORYTEST
bool "factorytest"
help
  Product line test suit.
```

## package/k1x-cam/Config.in
```kconfig
config BR2_PACKAGE_K1X_CAM
	bool "k1x-cam"
	default y
	help
	  Spacemit k1x camera demo test and camera lib.

if BR2_PACKAGE_K1X_CAM

config BR2_PACKAGE_K1X_CAM_LIB
	bool "k1x-cam-lib"
	default y
	help
	  Spacemit k1x camera lib.

config BR2_PACKAGE_K1X_CAM_TEST
	bool "k1x-cam-test"
	default y
	help
	  Spacemit k1x camera demo test.
endif
```

## package/k1x-gpu-test/Config.in
```kconfig
config BR2_PACKAGE_K1X_GPU_TEST
	bool "k1x-gpu-test"
	default n
	depends on BR2_PACKAGE_HAS_LIBEGL
	depends on BR2_PACKAGE_HAS_LIBGLES
	depends on BR2_PACKAGE_WAYLAND && BR2_PACKAGE_WESTON
	help
	  Spacemit k1x gpu driver test.
```

## package/k1x-jpu/Config.in
```kconfig
config BR2_PACKAGE_K1X_JPU
	bool "k1x-jpu"
	help
	  Spacemit k1x jpu library and  test.
```

## package/k1x-vpu-firmware/Config.in
```kconfig
config BR2_PACKAGE_K1X_VPU_FIRMWARE
	bool "k1x-vpu-firmware"
	help
	  Spacemit k1x vpu driver firmware.
```

## package/k1x-vpu-test/Config.in
```kconfig
config BR2_PACKAGE_K1X_VPU_TEST
	bool "k1x-vpu-test"
	help
	  Spacemit k1x vpu driver test.
```

## package/rtk-hciattach/Config.in
```kconfig
config BR2_PACKAGE_RTK_HCIATTACH
	bool "rtk hciattach"
	help
	  rtk hci attach tool to init bt and download firmware
```

## package/vk-gl-cts/Config.in
```kconfig
comment "vk-gl-cts package"

config BR2_PACKAGE_VK_GL_CTS
	bool "vk-gl-cts"
	help
	  vk-gl-cts package
```
