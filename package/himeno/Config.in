## package/himeno/Config.in
```kconfig
config BR2_PACKAGE_HIMENO
	bool "himeno"
	select BR2_PACKAGE_OPENMPI
	help
	  C + MPI, dynamic allocate version

	  https://github.com/calorie/himeno_benchmark
```

## package/jdk/Config.in
```kconfig
config BR2_PACKAGE_JDK
	bool "jobot development kit(JDK)"
	default n
    select BR2_PACKAGE_MPP
	help
	  Spacemit jobot development kit(JDK), 
	  Encapsulates the MPP and multimedia processing pipeline to reduce data copying and data latency.
```

## package/jetson-utils/Config.in
```kconfig
config BR2_PACKAGE_JETSON_UTILS
	bool "k1 jetson-utils lib"
	default y
	help
	  Spacemit k1 jetson-utils lib.
```

## package/k3x-vpu-firmware/Config.in
```kconfig
config BR2_PACKAGE_K3X_VPU_FIRMWARE
	bool "k3x-vpu-firmware"
	help
	  Spacemit k3x vpu driver firmware.
```

## package/k3x-vpu-test/Config.in
```kconfig
config BR2_PACKAGE_K3X_VPU_TEST
	bool "k3x-vpu-test"
	help
	  Spacemit k3x vpu driver test.
```

## package/linpack/Config.in
```kconfig
config BR2_PACKAGE_LINPACK
	bool "linpack"
	help
	  a C code which carries out the LINPACK benchmark program.

	  https://people.sc.fsu.edu/~jburkardt/c_src/linpack_bench/linpack_bench.html
```

## package/llama-cpp/Config.in
```kconfig
config BR2_PACKAGE_LLAMA_CPP
	bool "llama.cpp"
	select BR2_PACKAGE_SPINE_TCM

	help
	    Customized Version of llama.cpp
```

## package/lvgl/Config.in
```kconfig
config BR2_PACKAGE_LVGL
    bool "LVGL support"
    default n
	help
	  LVGL framwork and demo.
```

## package/lzbench/Config.in
```kconfig
config BR2_PACKAGE_LZBENCH
	bool "lzbench"
	help
	
	  lzbench is an in-memory benchmark of open-source LZ77/LZSS/LZMA compressors.

	  https://github.com/inikep/lzbench
```

## package/m-queens/Config.in
```kconfig
config BR2_PACKAGE_M_QUEENS
	bool "m-queens"

	help
	  Multi-queens, a very fast solver for the general eight queens problem with OpenMP support.

	  https://github.com/sudden6/m-queens
```

## package/mafft/Config.in
```kconfig
config BR2_PACKAGE_MAFFT
	bool "mafft"
	help
	  MAFFT: a multiple sequence alignment program 

	  http://mafft.cbrc.jp/alignment/software/
```

## package/mibench/Config.in
```kconfig
config BR2_PACKAGE_MIBENCH
	bool "mibench"

	help
	  MiBench: A free, commercially representative embedded benchmark suite

	  https://github.com/embecosm/mibench
```

## package/mpp/Config.in
```kconfig
comment "spacemit mpp package"

config BR2_PACKAGE_MPP
	bool "spacemit mpp"
	select BR2_PACKAGE_SDL2
	help
	  spacemit mpp package
```

## package/nbench/Config.in
```kconfig
config BR2_PACKAGE_NBENCH
    bool "nbench"
    help
      Linux/Unix nbench (previously known as BYTE's Native Mode Benchmarks)

      https://github.com/toshsan/nbench
```

## package/ncnn/Config.in
```kconfig
config BR2_PACKAGE_NCNN
	bool "ncnn"
	help
	ncnn is a high-performance neural network inference computing framework 
	optimized for mobile platforms.
	https://github.com/Tencent/ncnn
```

## package/oabenchv2/Config.in
```kconfig
config BR2_PACKAGE_OABENCHV2
	bool "oabenchv2"
	help
	OABench 2.0 is a second-generation suite of benchmarks that 
	allows the user to approximate the performance of processors in 
	printers, plotters, and other office automation systems that 
	handle text and image processing tasks.
	
	  https://github.com/eembc/oabenchv2
```

## package/onnx-runtime/Config.in
```kconfig
config BR2_PACKAGE_ONNX_RUNTIME
        bool "ONNX Runtime"
        select BR2_PACKAGE_SPINE_TCM

        help
            Customized Version of ONNX Runtime
```

## package/postmark/Config.in
```kconfig
config BR2_PACKAGE_POSTMARK
	bool "postmark"
	help
	  postmark

	  https://github.com/Andiry/postmark

comment "postmark"
```

## package/primesieve/Config.in
```kconfig
config BR2_PACKAGE_PRIMESIEVE
	bool "primesieve"
	help
	  primesieve is a command-line program and C/C++ library for quickly generating prime numbers.

	  https://github.com/kimwalisch/primesieve
```

## package/scimark2/Config.in
```kconfig
config BR2_PACKAGE_SCIMARK2
	bool "scimark2"
	help
	  SciMark 2.0 is a C benchmark for scientific and numerical computing.  

	  https://github.com/kunjara/swetest
```

## package/secure-firmware/Config.in
```kconfig
config BR2_PACKAGE_SECURE_FIRMWARE
	bool "build secure firmware set (OP-TEE itb + secure u-boot) into images/sec/"
	depends on BR2_TARGET_UBOOT
	depends on BR2_TARGET_OPTEE_OS
	help
	  Single pseudo-package producing the whole secure (OP-TEE) firmware
	  set under images/sec/, mirroring the k3-dev BSP SDK output/sec/:
	    - optee.itb  : tee.bin packed as a standalone FIT (its maintained
	                   in optee_os plat-k3/, single source of truth)
	    - secure u-boot variant (k3_sec.config merged) : u-boot.itb,
	                   FSBL.bin, env.bin (optee mtdparts), u-boot-nodtb.bin,
	                   spl/u-boot-spl.bin, uboot/*.dtb (tdomain/udomain)
	    - tee.bin relocated under sec/ (non-secure images/ root stays
	                   tee-free)
	  Depends on the normal (non-secure) uboot having been built first
	  (its build dir is reused for the in-place secure re-build); the
	  non-secure .config/env are restored afterwards.

	  Chips without configs/<chip>_sec.config skip the secure u-boot
	  re-build but still get optee.itb packed.

comment "secure firmware needs u-boot + optee-os"
	depends on !BR2_TARGET_UBOOT || !BR2_TARGET_OPTEE_OS
```

## package/smallpt/Config.in
```kconfig
config BR2_PACKAGE_SMALLPT
	bool "smallpt"
	help
	  C modification of Kevin Baeson's 99 line C path tracer

	  https://github.com/matt77hias/c-smallpt
```

## package/spine-tcm/Config.in
```kconfig
config BR2_PACKAGE_SPINE_TCM
	bool "spine-tcm"

	help
	    SpacemiT TCM (Tightly Coupled Memory) support library
```

## package/stockfish/Config.in
```kconfig
config BR2_PACKAGE_STOCKFISH
	bool "stockfish"

	help
	  Stockfish is a free and strong UCI chess engine derived from Glaurung 2.1 
	  that analyzes chess positions and computes the optimal moves.

	  https://github.com/official-stockfish/Stockfish
```

## package/stream/Config.in
```kconfig
config BR2_PACKAGE_STREAM
    bool "stream"
    help
      STREAM is the de facto industry standard benchmark
      for measuring sustained memory bandwidth.

      http://www.cs.virginia.edu/stream/ref.html
```
