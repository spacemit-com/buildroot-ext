## package/swetest/Config.in
```kconfig
config BR2_PACKAGE_SWETEST
	bool "swetest"
	help
	  The Swiss Ephemeris is the high precision ephemeris developed by Astrodienst, 
	  largely based upon the DExxx ephemerides from NASA's JPL. 

	  https://github.com/kunjara/swetest
```

## package/sysbench/Config.in
```kconfig
config BR2_PACKAGE_SYSBENCH
    bool "sysbench"
    depends on BR2_PACKAGE_CK
    help
      Scriptable database and system performance benchmark

      https://github.com/akopytov/sysbench
```

## package/tachyon/Config.in
```kconfig
config BR2_PACKAGE_TACHYON
	bool "tachyon"
	help
	  Tachyon is an efficient, parallelised raytracer

	  https://github.com/thesketh/Tachyon
```

## package/telebench/Config.in
```kconfig
config BR2_PACKAGE_TELEBENCH
	bool "telebench"
	help
	  TeleBench is a suite of benchmarks that allows the users to approximate the performance of
	   processors in modem and related fixed-telecom applications

	  https://github.com/eembc/telebench.git
```

## package/tiobench/Config.in
```kconfig
config BR2_PACKAGE_TIOBENCH
	bool "tiobench"
	help
	  The tiobench is a Threaded I/O bench for Linux

	  https://github.com/mkuoppal/tiobench
```

## package/tscp/Config.in
```kconfig
config BR2_PACKAGE_TSCP
	bool "tscp"

	help
	  Tom Kerrigan’s Simple Chess Program (TSCP) is a small, 
	  open-source chess engine that I made in 1997.
	  It’s a tutorial engine, i.e., it’s designed to teach people how chess engines work.

	  https://github.com/search?q=TSCP
```

## package/uboot-env-custom/Config.in
```kconfig
config BR2_PACKAGE_UBOOT_ENV_CUSTOM
	bool "compile the custom uboot env file"
	help
        will compile the custom env file and then be packed by genimage 

if BR2_PACKAGE_UBOOT_ENV_CUSTOM

config BR2_PACKAGE_UBOOT_ENV_CUSTOM_FILE
	string "env file path"
	default ""

endif #BR2_PACKAGE_UBOOT_ENV_CUSTOM
```

## package/usb-gadget/Config.in
```kconfig
config BR2_PACKAGE_USB_GADGET
	bool "usb-gadget"
	default n
	help
	  usb gadget, include uvc,rndis,mass storage,uas,adb functions
```

## package/xsbench/Config.in
```kconfig
config BR2_PACKAGE_XSBENCH
	bool "xsbench"
	help
	  XSBench is a mini-app representing a key computational kernel of the Monte Carlo neutron transport algorithm.

	  https://github.com/ANL-CESAR/XSBench
```
