## board/spacemit/k1-x_fpga/opensbi-fit.its
```
/dts-v1/;

/ {
	description = "sbi FIT image for k1x";
	#address-cells = <2>;

	images {
		firmware {
			description = "opensbi";
			data = /incbin/("./fw_dynamic.bin");
			type = "firmware";
			arch = "riscv";
			os = "opensbi";
			load = <0x0 0x46000000>;
			compression = "none";
		};
		
	};

	configurations {
		default = "config";
		config {
			description = "sbi FIT config for k1x";
			firmware = "firmware";
		};
	};
};
```

## board/spacemit/k1-x_fpga/uboot_fit.its
```
/dts-v1/;

/ {
	description = "U-boot FIT image for k1x";
	#address-cells = <2>;

	images {
		firmware {
			description = "u-boot";
			data = /incbin/("./fw_payload.bin");
			type = "firmware";
			arch = "riscv";
			os = "u-boot";
			load = <0x0 0x00100000>;
			entry = <0x0 0x00100000>;
			compression = "none";
		};
	};

	configurations {
		default = "config-1";
		config-1 {
			description = "U-boot FIT config for k1x";
			firmware = "firmware";
		};
	};
};
```

## board/spacemit/k1/kernel_fdt.its
```
/*
 * FIT Image source file containing a single kernel
 */

/dts-v1/;

/ {
	description = "Image with single Linux kernel";
	#address-cells = <2>;

	images {
		kernel {
			description = "Spacemit K1 Linux kernel";
			data = /incbin/("./Image");
			type = "kernel";
			arch = "riscv";
			os = "linux";
			compression = "none";
			load = <0x0 0x1400000>;
			entry = <0x0 0x1400000>;
		};
	};

	configurations {
		default = "conf-1";
		conf-1 {
			description = "K1 universal FIT Image";
			kernel = "kernel";
		};
	};
};
```

## board/spacemit/k1x-deb2/uboot-opensbi.its
```
/dts-v1/;

/ {
	description = "U-boot FIT image for k1x";
	#address-cells = <2>;
	fit,fdt-list = "of-list";

	images {
		uboot {
			description = "U-Boot";
			type = "standalone";
			os = "U-Boot";
			arch = "riscv";
			compression = "none";
			load = <0x0 0x00200000>;
			data = /incbin/("./u-boot-nodtb.bin");
		};

		opensbi {
			description = "OpenSBI fw_dynamic Firmware";
			type = "firmware";
			os = "opensbi";
			arch = "riscv";
			compression = "none";
			load = <0x0 0x0>;
			entry = <0x0 0x0>;
			data = /incbin/("./fw_dynamic.bin");
		};

		fdt_1 {
			description = "Flattened Device Tree blob";
			type = "flat_dt";
			compression = "none";
			data = /incbin/("./u-boot.dtb");
		};

	};

	configurations {
		default = "config-1";
		config-1 {
			description = "U-boot FIT config for k1x";
			firmware = "opensbi";
			loadables = "uboot";
			fdt = "fdt_1";
		};
	};
};
```

## board/spacemit/k1x-evb/kernel_fdt.its
```
/*
 * Simple U-Boot uImage source file containing a single kernel and FDT blob
 */

/dts-v1/;

/ {
	description = "Simple image with single Linux kernel and FDT blob";
	#address-cells = <2>;

	images {
		kernel {
			description = "Vanilla Linux kernel";
			data = /incbin/("./Image");
			type = "kernel";
			arch = "riscv";
			os = "linux";
			compression = "none";
			load = <0x0 0x21000000>;
			entry = <0x0 0x21000000>;
		};
		fdt-1 {
			description = "Flattened Device Tree blob";
			data = /incbin/("./k1-x_fpga.dtb");
			type = "flat_dt";
			arch = "riscv";
			compression = "none";
			load = <0x0 0x28000000>;
		};
	};

	configurations {
		default = "conf-1";
		conf-1 {
			description = "Boot Linux kernel with FDT blob";
			kernel = "kernel";
			fdt = "fdt-1";
		};
	};
};
```

## board/spacemit/k1x-fpga/uboot-fit.its
```
/dts-v1/;

/ {
	description = "U-boot FIT image for k1x";
	#address-cells = <2>;

	images {
		firmware {
			description = "u-boot";
			data = /incbin/("./u-boot-nodtb.bin");
			type = "firmware";
			arch = "riscv";
			os = "u-boot";
			load = <0x0 0x00100000>;
			entry = <0x0 0x00100000>;
			compression = "none";
		};
		fdt {
			description = "u-boot dtb";
			data = /incbin/("./u-boot.dtb");
			type = "flat_dt";
			arch = "riscv";
			load = <0x0 0x46100000>;
			compression = "none";
		};

		fdt1 {
			description = "u-boot dtb";
			data = /incbin/("./u-boot.dtb");
			type = "flat_dt";
			arch = "riscv";
			load = <0x0 0x46100000>;
			compression = "none";
		};
	};

	configurations {
		default = "deconfig";
		deconfig {
			description = "U-boot FIT config for k1x";
			firmware = "firmware";
			fdt = "fdt";
		};
		config-1 {
			description = "U-boot FIT config for k1x";
			firmware = "firmware";
			fdt = "fdt1";
		};
	};
};
```

## configs/spacemit_k1-x_benchmark_defconfig
```kconfig
BR2_riscv=y
BR2_TOOLCHAIN_EXTERNAL=y
BR2_TOOLCHAIN_EXTERNAL_CUSTOM=y
BR2_TOOLCHAIN_EXTERNAL_DOWNLOAD=y
BR2_TOOLCHAIN_EXTERNAL_URL="http://lnode1.dc.com:20000/software/toolchain/spacemit-gcc-linux-glibc-x86_64-jdsk-v0.1.5-20230324T022642.tar.gz"
BR2_TOOLCHAIN_EXTERNAL_CUSTOM_PREFIX="$(ARCH)-unknown-linux-gnu"
BR2_TOOLCHAIN_EXTERNAL_HEADERS_5_10=y
BR2_TOOLCHAIN_EXTERNAL_CUSTOM_GLIBC=y
# BR2_TOOLCHAIN_EXTERNAL_INET_RPC is not set
BR2_TOOLCHAIN_EXTERNAL_CXX=y
BR2_TOOLCHAIN_EXTERNAL_FORTRAN=y
BR2_TOOLCHAIN_EXTERNAL_OPENMP=y
BR2_PACKAGE_OVERRIDE_FILE="$(TOPDIR)/../buildroot-ext/local.mk"
BR2_GLOBAL_PATCH_DIR="$(TOPDIR)/../buildroot-ext/patches/"
BR2_SYSTEM_DHCP="eth0"
BR2_ROOTFS_OVERLAY="$(BR2_EXTERNAL_Bianbu_PATH)/board/spacemit/k1-x_fpga/overlay"
BR2_ROOTFS_POST_IMAGE_SCRIPT="$(BR2_EXTERNAL_Bianbu_PATH)/board/spacemit/k1-x_fpga/overlay_rootfs_img.sh support/scripts/genimage.sh"
BR2_ROOTFS_POST_SCRIPT_ARGS="-c $(BR2_EXTERNAL_Bianbu_PATH)/board/spacemit/k1-x_fpga/genimage.cfg"
BR2_LINUX_KERNEL=y
BR2_LINUX_KERNEL_USE_CUSTOM_CONFIG=y
BR2_LINUX_KERNEL_CUSTOM_CONFIG_FILE="$(LINUX_OVERRIDE_SRCDIR)/arch/riscv/configs/k1-x_fpga_defconfig"
BR2_LINUX_KERNEL_DTS_SUPPORT=y
BR2_LINUX_KERNEL_INTREE_DTS_NAME="spacemit/k1-x_fpga"
BR2_PACKAGE_BZIP2=y
BR2_PACKAGE_MEMTESTER=y
BR2_PACKAGE_ZLIB=y
BR2_PACKAGE_NCURSES=y
BR2_PACKAGE_PCRE=y
BR2_PACKAGE_PCRE_UCP=y
BR2_TARGET_ROOTFS_CPIO=y
BR2_TARGET_ROOTFS_CPIO_DRACUT=y
BR2_TARGET_ROOTFS_CPIO_GZIP=y
BR2_TARGET_ROOTFS_EXT2=y
BR2_TARGET_ROOTFS_EXT2_4=y
BR2_TARGET_ROOTFS_EXT2_SIZE="300M"
# BR2_TARGET_ROOTFS_TAR is not set
BR2_TARGET_OPENSBI=y
BR2_TARGET_OPENSBI_PLAT="generic"
# BR2_TARGET_OPENSBI_INSTALL_JUMP_IMG is not set
BR2_TARGET_OPENSBI_ADDITIONAL_VARIABLES="PLATFORM_DEFCONFIG=k1-x_fpga_defconfig"
BR2_TARGET_UBOOT=y
BR2_TARGET_UBOOT_USE_CUSTOM_CONFIG=y
BR2_TARGET_UBOOT_CUSTOM_CONFIG_FILE="$(UBOOT_OVERRIDE_SRCDIR)/configs/k1-x_fpga_defconfig"
# BR2_TARGET_UBOOT_FORMAT_BIN is not set
BR2_TARGET_UBOOT_FORMAT_DTB=y
BR2_TARGET_UBOOT_FORMAT_CUSTOM=y
BR2_TARGET_UBOOT_FORMAT_CUSTOM_NAME="u-boot-nodtb.bin"
BR2_TARGET_UBOOT_SPL=y
BR2_TARGET_UBOOT_SPL_NAME="spl/u-boot-spl.bin spl/u-boot-spl.dtb spl/u-boot-spl-nodtb.bin"
BR2_PACKAGE_HOST_CMAKE=y
BR2_PACKAGE_HOST_GENIMAGE=y
BR2_TARGET_BOOTFS=y
BR2_PACKAGE_UBOOT_ENV_CUSTOM=y
BR2_PACKAGE_UBOOT_ENV_CUSTOM_FILE="$(BR2_EXTERNAL_Bianbu_PATH)/board/spacemit/k1-x_fpga/env.txt"
BR2_PACKAGE_LINPACK=y
BR2_PACKAGE_STREAM=y
BR2_PACKAGE_CSMITH=y
BR2_PACKAGE_POSTMARK=y
BR2_PACKAGE_FHOURSTONES88=y
BR2_PACKAGE_BLOGBENCH=y
BR2_PACKAGE_TACHYON=y
BR2_PACKAGE_SWETEST=y
BR2_PACKAGE_SCIMARK2=y
BR2_PACKAGE_MAFFT=y
BR2_PACKAGE_CLOMP=y
BR2_PACKAGE_LZBENCH=y
BR2_PACKAGE_CRAY=y
BR2_PACKAGE_HIMENO=y
BR2_PACKAGE_SMALLPT=y
BR2_PACKAGE_FSMARK=y
BR2_PACKAGE_TIOBENCH=y
BR2_PACKAGE_DCRAW=y
BR2_PACKAGE_AOBENCH=y
BR2_PACKAGE_M_QUEENS=y
BR2_PACKAGE_TSCP=y
BR2_PACKAGE_STOCKFISH=y
BR2_PACKAGE_NBENCH=y
BR2_PACKAGE_AOM_AV1_PSY=y
BR2_PACKAGE_PRIMESIEVE=y
BR2_PACKAGE_TELEBENCH=y
BR2_PACKAGE_OABENCHV2=y
BR2_PACKAGE_XSBENCH=y
BR2_PACKAGE_NCNN=y
```

## configs/spacemit_k1-x_evb_defconfig
```kconfig
BR2_riscv=y
BR2_TOOLCHAIN_EXTERNAL=y
BR2_TOOLCHAIN_EXTERNAL_CUSTOM=y
BR2_TOOLCHAIN_EXTERNAL_DOWNLOAD=y
BR2_TOOLCHAIN_EXTERNAL_URL="http://lnode1.dc.com:20000/software/toolchain/spacemit-gcc-linux-glibc-x86_64-jdsk-v0.1.5-20230324T022642.tar.gz"
BR2_TOOLCHAIN_EXTERNAL_CUSTOM_PREFIX="$(ARCH)-unknown-linux-gnu"
BR2_TOOLCHAIN_EXTERNAL_HEADERS_5_10=y
BR2_TOOLCHAIN_EXTERNAL_CUSTOM_GLIBC=y
# BR2_TOOLCHAIN_EXTERNAL_INET_RPC is not set
BR2_TOOLCHAIN_EXTERNAL_CXX=y
BR2_TOOLCHAIN_EXTERNAL_FORTRAN=y
BR2_TOOLCHAIN_EXTERNAL_OPENMP=y
BR2_CCACHE=y
BR2_PACKAGE_OVERRIDE_FILE="$(TOPDIR)/../buildroot-ext/local.mk"
BR2_GLOBAL_PATCH_DIR="$(TOPDIR)/../buildroot-ext/patches/"
BR2_ROOTFS_DEVICE_CREATION_DYNAMIC_EUDEV=y
BR2_SYSTEM_DHCP="eth0"
BR2_TARGET_TZ_INFO=y
BR2_ROOTFS_OVERLAY="$(BR2_EXTERNAL_Bianbu_PATH)/board/spacemit/k1x-evb/target_overlay"
BR2_ROOTFS_POST_IMAGE_SCRIPT="$(BR2_EXTERNAL_Bianbu_PATH)/board/spacemit/k1x-evb/prepare_img.sh"
BR2_LINUX_KERNEL=y
BR2_LINUX_KERNEL_USE_CUSTOM_CONFIG=y
BR2_LINUX_KERNEL_CUSTOM_CONFIG_FILE="$(LINUX_OVERRIDE_SRCDIR)/arch/riscv/configs/k1-x_evb_defconfig"
BR2_LINUX_KERNEL_DTS_SUPPORT=y
BR2_LINUX_KERNEL_INTREE_DTS_NAME="spacemit/k1-x_evb"
BR2_PACKAGE_BZIP2=y
BR2_PACKAGE_E2FSPROGS=y
BR2_PACKAGE_WESTON=y
BR2_PACKAGE_MEMTESTER=y
BR2_PACKAGE_UBOOT_TOOLS=y
BR2_PACKAGE_UBOOT_TOOLS_FIT_SUPPORT=y
BR2_PACKAGE_UBOOT_TOOLS_FIT_SIGNATURE_SUPPORT=y
BR2_PACKAGE_UBOOT_TOOLS_FIT_CHECK_SIGN=y
BR2_PACKAGE_UBOOT_TOOLS_MKIMAGE=y
BR2_PACKAGE_UBOOT_TOOLS_MKENVIMAGE=y
BR2_PACKAGE_UBOOT_TOOLS_DUMPIMAGE=y
BR2_PACKAGE_JASPER=y
BR2_PACKAGE_LCMS2=y
BR2_PACKAGE_OPENMPI=y
BR2_PACKAGE_NCURSES=y
BR2_PACKAGE_PCRE=y
BR2_PACKAGE_PCRE_UCP=y
BR2_TARGET_ROOTFS_CPIO=y
BR2_TARGET_ROOTFS_CPIO_DRACUT=y
BR2_TARGET_ROOTFS_CPIO_GZIP=y
BR2_TARGET_ROOTFS_EXT2=y
BR2_TARGET_ROOTFS_EXT2_4=y
BR2_TARGET_ROOTFS_EXT2_SIZE="300M"
# BR2_TARGET_ROOTFS_TAR is not set
BR2_TARGET_OPENSBI=y
BR2_TARGET_OPENSBI_PLAT="generic"
# BR2_TARGET_OPENSBI_INSTALL_JUMP_IMG is not set
BR2_TARGET_OPENSBI_ADDITIONAL_VARIABLES="PLATFORM_DEFCONFIG=k1-x_evb_defconfig"
BR2_TARGET_UBOOT=y
BR2_TARGET_UBOOT_USE_CUSTOM_CONFIG=y
BR2_TARGET_UBOOT_CUSTOM_CONFIG_FILE="$(UBOOT_OVERRIDE_SRCDIR)/configs/k1-x_evb_defconfig"
BR2_TARGET_UBOOT_FORMAT_CUSTOM=y
BR2_TARGET_UBOOT_FORMAT_CUSTOM_NAME="u-boot.itb"
BR2_TARGET_UBOOT_SPL=y
BR2_TARGET_UBOOT_SPL_NAME="spl/u-boot-spl.bin spl/u-boot-spl.dtb spl/u-boot-spl-nodtb.bin"
BR2_PACKAGE_HOST_CMAKE=y
BR2_PACKAGE_HOST_GENIMAGE=y
BR2_PACKAGE_HOST_JQ=y
BR2_PACKAGE_HOST_UBOOT_TOOLS=y
BR2_PACKAGE_HOST_UBOOT_TOOLS_FIT_SUPPORT=y
BR2_PACKAGE_HOST_UBOOT_TOOLS_FIT_SIGNATURE_SUPPORT=y
BR2_PACKAGE_PARTITIONS="$(BR2_EXTERNAL_Bianbu_PATH)/board/spacemit/k1x-evb/partitions.json"
BR2_PACKAGE_MPP=y
BR2_PACKAGE_IMG_GPU_POWERVR=y
BR2_PACKAGE_IMG_GPU_POWERVR_OUTPUT_WL=y
```

## configs/spacemit_k1_benchmark_defconfig
```kconfig
BR2_riscv=y
BR2_TOOLCHAIN_EXTERNAL=y
BR2_SYSTEM_DHCP="eth0"
BR2_ROOTFS_OVERLAY="board/visionfive2/overlay"
BR2_ROOTFS_POST_IMAGE_SCRIPT="support/scripts/genimage.sh"
BR2_ROOTFS_POST_SCRIPT_ARGS="-c board/visionfive/genimage.cfg"
BR2_LINUX_KERNEL=y
BR2_LINUX_KERNEL_CUSTOM_DIR=y
BR2_LINUX_KERNEL_CUSTOM_DIR_LOCATION="$(TOPDIR)/../bsp-src/linux-6.1"
BR2_LINUX_KERNEL_USE_CUSTOM_CONFIG=y
BR2_LINUX_KERNEL_CUSTOM_CONFIG_FILE="$(TOPDIR)/../bsp-src/linux-6.1/arch/riscv/configs/k1-pro_fpga_defconfig"
BR2_LINUX_KERNEL_DTS_SUPPORT=y
BR2_LINUX_KERNEL_DTB_IS_SELF_BUILT=y
BR2_LINUX_KERNEL_CUSTOM_DTS_PATH="$(TOPDIR)/../bsp-src/devices/k1-pro/fpga/board.dts"
BR2_PACKAGE_COREMARK=y
BR2_PACKAGE_COREMARK_PRO=y
BR2_PACKAGE_DHRYSTONE=y
BR2_PACKAGE_FIO=y
BR2_PACKAGE_IOZONE=y
BR2_PACKAGE_LATENCYTOP=y
BR2_PACKAGE_LMBENCH=y
BR2_PACKAGE_LTP_TESTSUITE=y
BR2_PACKAGE_MBW=y
BR2_PACKAGE_MEMSTAT=y
BR2_PACKAGE_NETPERF=y
BR2_PACKAGE_RAMSMP=y
BR2_PACKAGE_RAMSPEED=y
BR2_PACKAGE_STRESS_NG=y
BR2_PACKAGE_TINYMEMBENCH=y
BR2_PACKAGE_WHETSTONE=y
BR2_PACKAGE_LINPACK=y
BR2_PACKAGE_STREAM=y
BR2_PACKAGE_CSMITH=y
BR2_PACKAGE_POSTMARK=y
BR2_PACKAGE_FHOURSTONES88=y
BR2_PACKAGE_BLOGBENCH=y
BR2_PACKAGE_TACHYON=y
BR2_PACKAGE_SWETEST=y
BR2_PACKAGE_SCIMARK2=y
BR2_PACKAGE_MAFFT=y
BR2_PACKAGE_CLOMP=y
BR2_PACKAGE_LZBENCH=y
BR2_PACKAGE_CRAY=y
BR2_PACKAGE_HIMENO=y
BR2_PACKAGE_SMALLPT=y
BR2_PACKAGE_FSMARK=y
BR2_PACKAGE_TIOBENCH=y
BR2_PACKAGE_DCRAW=y
BR2_PACKAGE_AOBENCH=y
BR2_PACKAGE_M_QUEENS=y
BR2_PACKAGE_TSCP=y
BR2_PACKAGE_STOCKFISH=y
BR2_PACKAGE_NBENCH=y
BR2_PACKAGE_MIBENCH=y
BR2_PACKAGE_AOM_AV1_PSY=y
BR2_PACKAGE_PRIMESIEVE=y
BR2_PACKAGE_TELEBENCH=y
BR2_PACKAGE_OABENCHV2=y
BR2_PACKAGE_XSBENCH=y
BR2_PACKAGE_GRAPHICSMAGICK=y
BR2_PACKAGE_MEMTESTER=y
BR2_PACKAGE_SNAPPY=y
BR2_PACKAGE_BOTAN=y
BR2_PACKAGE_MBEDTLS=y
BR2_PACKAGE_MBEDTLS_PROGRAMS=y
BR2_PACKAGE_MBEDTLS_COMPRESSION=y
BR2_PACKAGE_MBEDTLS_DTLS_SRTP=y
BR2_PACKAGE_WOLFSSL=y
BR2_PACKAGE_WOLFSSL_ALL=y
BR2_PACKAGE_WOLFSSL_SSLV3=y
BR2_PACKAGE_LIBPNG=y
BR2_PACKAGE_OPENCV3=y
BR2_PACKAGE_OPENCV3_LIB_OBJDETECT=y
BR2_PACKAGE_OPENCV3_LIB_SHAPE=y
BR2_PACKAGE_OPENCV3_LIB_VIDEOIO=y
BR2_PACKAGE_OPENCV3_LIB_VIDEOSTAB=y
BR2_PACKAGE_OPENCV3_BUILD_TESTS=y
BR2_PACKAGE_OPENCV3_BUILD_PERF_TESTS=y
BR2_PACKAGE_OPENCV3_WITH_FFMPEG=y
BR2_PACKAGE_LIBOGG=y
BR2_PACKAGE_FFTW=y
BR2_PACKAGE_PROTOBUF=y
BR2_PACKAGE_IPERF3=y
BR2_PACKAGE_OPENSSH=y
BR2_TARGET_ROOTFS_EXT2=y
BR2_TARGET_ROOTFS_EXT2_4=y
BR2_TARGET_ROOTFS_EXT2_SIZE="900M"
# BR2_TARGET_ROOTFS_TAR is not set
BR2_TARGET_OPENSBI=y
BR2_TARGET_OPENSBI_CUSTOM_LOCAL=y
BR2_TARGET_OPENSBI_CUSTOM_LOCAL_DIR="$(TOPDIR)/../bsp-src/opensbi"
BR2_TARGET_OPENSBI_PLAT="spacemit/k1-pro"
# BR2_TARGET_OPENSBI_INSTALL_DYNAMIC_IMG is not set
BR2_TARGET_UBOOT=y
BR2_TARGET_UBOOT_BUILD_SYSTEM_KCONFIG=y
BR2_TARGET_UBOOT_CUSTOM_DIR=y
BR2_TARGET_UBOOT_CUSTOM_DIR_LOCATION="$(TOPDIR)/../bsp-src/uboot-2022.10"
BR2_TARGET_UBOOT_USE_CUSTOM_CONFIG=y
BR2_TARGET_UBOOT_CUSTOM_CONFIG_FILE="$(TOPDIR)/../bsp-src/uboot-2022.10/configs/k1-pro_fpga_defconfig"
BR2_TARGET_UBOOT_FORMAT_DTB=y
BR2_TARGET_UBOOT_FORMAT_DTB_BIN=y
BR2_TARGET_UBOOT_FORMAT_IMG=y
BR2_TARGET_UBOOT_FORMAT_DTB_IMG=y
BR2_TARGET_UBOOT_SPL=y
BR2_PACKAGE_HOST_CMAKE=y
BR2_PACKAGE_HOST_GENIMAGE=y
```

## configs/spacemit_k1_fpga_defconfig
```kconfig
BR2_riscv=y
BR2_TOOLCHAIN_EXTERNAL=y
BR2_SYSTEM_DHCP="eth0"
BR2_ROOTFS_OVERLAY="$(BR2_EXTERNAL_k1_PATH)/board/k1-fpga/overlay"
BR2_ROOTFS_POST_IMAGE_SCRIPT="support/scripts/genimage.sh"
BR2_ROOTFS_POST_SCRIPT_ARGS="-c $(BR2_EXTERNAL_k1_PATH)/board/k1-fpga/genimage.cfg"
BR2_LINUX_KERNEL=y
BR2_LINUX_KERNEL_CUSTOM_DIR=y
BR2_LINUX_KERNEL_CUSTOM_DIR_LOCATION="$(TOPDIR)/../bsp-src/linux-6.1"
BR2_LINUX_KERNEL_USE_CUSTOM_CONFIG=y
BR2_LINUX_KERNEL_CUSTOM_CONFIG_FILE="$(TOPDIR)/../bsp-src/linux-6.1/arch/riscv/configs/k1-pro_fpga_defconfig"
BR2_LINUX_KERNEL_DTS_SUPPORT=y
BR2_LINUX_KERNEL_DTB_IS_SELF_BUILT=y
BR2_LINUX_KERNEL_CUSTOM_DTS_PATH="$(TOPDIR)/../bsp-src/devices/k1-pro/fpga/board.dts"
BR2_PACKAGE_BZIP2=y
BR2_PACKAGE_MEMTESTER=y
BR2_PACKAGE_ZLIB=y
BR2_PACKAGE_NCURSES=y
BR2_PACKAGE_PCRE=y
BR2_PACKAGE_PCRE_UCP=y
BR2_TARGET_ROOTFS_EXT2=y
BR2_TARGET_ROOTFS_EXT2_4=y
BR2_TARGET_ROOTFS_EXT2_SIZE="10M"
# BR2_TARGET_ROOTFS_TAR is not set
BR2_TARGET_OPENSBI=y
BR2_TARGET_OPENSBI_CUSTOM_LOCAL=y
BR2_TARGET_OPENSBI_CUSTOM_LOCAL_DIR="$(TOPDIR)/../bsp-src/opensbi"
BR2_TARGET_OPENSBI_PLAT="spacemit/k1-pro"
# BR2_TARGET_OPENSBI_INSTALL_DYNAMIC_IMG is not set
BR2_TARGET_UBOOT=y
BR2_TARGET_UBOOT_BUILD_SYSTEM_KCONFIG=y
BR2_TARGET_UBOOT_CUSTOM_DIR=y
BR2_TARGET_UBOOT_CUSTOM_DIR_LOCATION="$(TOPDIR)/../bsp-src/uboot-2022.10"
BR2_TARGET_UBOOT_USE_CUSTOM_CONFIG=y
BR2_TARGET_UBOOT_CUSTOM_CONFIG_FILE="$(TOPDIR)/../bsp-src/uboot-2022.10/configs/k1-pro_fpga_defconfig"
# BR2_TARGET_UBOOT_FORMAT_BIN is not set
BR2_TARGET_UBOOT_FORMAT_DTB=y
BR2_TARGET_UBOOT_FORMAT_DTB_BIN=y
BR2_TARGET_UBOOT_FORMAT_DTB_IMG=y
BR2_TARGET_UBOOT_FORMAT_CUSTOM=y
BR2_TARGET_UBOOT_FORMAT_CUSTOM_NAME="u-boot-nodtb.bin"
BR2_TARGET_UBOOT_SPL=y
BR2_TARGET_UBOOT_SPL_NAME="spl/u-boot-spl.bin spl/u-boot-spl.dtb spl/u-boot-spl-nodtb.bin"
BR2_PACKAGE_HOST_CMAKE=y
BR2_PACKAGE_HOST_GENIMAGE=y
BR2_PACKAGE_TCM=y
```
