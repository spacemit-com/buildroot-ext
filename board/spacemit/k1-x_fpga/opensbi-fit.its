## configs/spacemit_k3_fpga_defconfig
```kconfig
BR2_riscv=y
BR2_riscv_custom=y
BR2_RISCV_ISA_RVM=y
BR2_RISCV_ISA_RVA=y
BR2_RISCV_ISA_RVF=y
BR2_RISCV_ISA_RVD=y
BR2_RISCV_ISA_RVC=y
BR2_TOOLCHAIN_EXTERNAL=y
BR2_TOOLCHAIN_EXTERNAL_DOWNLOAD=y
BR2_TOOLCHAIN_EXTERNAL_URL="http://archive.spacemit.com/toolchain/spacemit-toolchain-linux-glibc-x86_64-v1.0.0.tar.xz"
BR2_TOOLCHAIN_EXTERNAL_REL_BIN_PATH="spacemit-toolchain-linux-glibc-x86_64-v1.0.0/bin"
BR2_TOOLCHAIN_EXTERNAL_CUSTOM_PREFIX="$(ARCH)-unknown-linux-gnu"
BR2_TOOLCHAIN_EXTERNAL_GCC_13=y
BR2_TOOLCHAIN_EXTERNAL_HEADERS_6_6=y
BR2_TOOLCHAIN_EXTERNAL_CUSTOM_GLIBC=y
# BR2_TOOLCHAIN_EXTERNAL_INET_RPC is not set
BR2_TOOLCHAIN_EXTERNAL_CXX=y
BR2_TOOLCHAIN_EXTERNAL_FORTRAN=y
BR2_TOOLCHAIN_EXTERNAL_OPENMP=y
BR2_PRIMARY_SITE="http://archive.spacemit.com/buildroot/dl"
BR2_CCACHE=y
BR2_PACKAGE_OVERRIDE_FILE="$(TOPDIR)/../buildroot-ext/local.mk"
BR2_TARGET_GENERIC_HOSTNAME="Bianbu"
BR2_TARGET_GENERIC_ISSUE="Welcome to Buildroot"
BR2_ROOTFS_DEVICE_CREATION_DYNAMIC_EUDEV=y
BR2_TARGET_GENERIC_ROOT_PASSWD="bianbu"
# BR2_ENABLE_LOCALE_PURGE is not set
BR2_GENERATE_LOCALE="C en_US.UTF-8 zh_CN.UTF-8"
BR2_ROOTFS_OVERLAY="$(BR2_EXTERNAL_Bianbu_PATH)/board/spacemit/k3/target_overlay"
BR2_ROOTFS_POST_BUILD_SCRIPT="$(BR2_EXTERNAL_Bianbu_PATH)/board/spacemit/k3/post-build.sh"
BR2_ROOTFS_POST_IMAGE_SCRIPT="$(BR2_EXTERNAL_Bianbu_PATH)/board/spacemit/k3/prepare_img.sh"
BR2_ROOTFS_POST_SCRIPT_ARGS="$(BR2_LINUX_KERNEL_IMAGE_TARGET_NAME)"
BR2_LINUX_KERNEL=y
BR2_LINUX_KERNEL_CUSTOM_DIR=y
BR2_LINUX_KERNEL_CUSTOM_DIR_LOCATION="$(TOPDIR)/../bsp-src/linux-6.12"
BR2_LINUX_KERNEL_USE_CUSTOM_CONFIG=y
BR2_LINUX_KERNEL_CUSTOM_CONFIG_FILE="$(LINUX_OVERRIDE_SRCDIR)/arch/riscv/configs/k3_defconfig"
BR2_LINUX_KERNEL_IMAGE_TARGET_CUSTOM=y
BR2_LINUX_KERNEL_IMAGE_TARGET_NAME="Image"
BR2_LINUX_KERNEL_IMAGE_NAME="Image"
BR2_LINUX_KERNEL_DTS_SUPPORT=y
BR2_LINUX_KERNEL_INTREE_DTS_NAME="spacemit/k3_fpga_1x1"
BR2_PACKAGE_LINUX_TOOLS_GPIO=y
BR2_PACKAGE_BUSYBOX_SHOW_OTHERS=y
BR2_PACKAGE_FFMPEG=y
BR2_PACKAGE_FFMPEG_GPL=y
BR2_PACKAGE_FFMPEG_ENABLE_SPACEMIT_MPP=y
BR2_PACKAGE_GZIP=y
BR2_PACKAGE_UNRAR=y
BR2_PACKAGE_UNZIP=y
BR2_PACKAGE_XZ=y
BR2_PACKAGE_ZIP=y
BR2_PACKAGE_DHRYSTONE=y
BR2_PACKAGE_FIO=y
BR2_PACKAGE_IOZONE=y
BR2_PACKAGE_LSOF=y
BR2_PACKAGE_MBW=y
BR2_PACKAGE_GETTEXT=y
BR2_PACKAGE_GREP=y
BR2_PACKAGE_JQ=y
BR2_PACKAGE_SED=y
BR2_PACKAGE_TREE=y
BR2_PACKAGE_E2FSPROGS=y
BR2_PACKAGE_E2FSPROGS_RESIZE2FS=y
BR2_PACKAGE_EXFAT_UTILS=y
BR2_PACKAGE_EXFATPROGS=y
BR2_PACKAGE_NFS_UTILS=y
BR2_PACKAGE_GLMARK2=y
BR2_PACKAGE_LIBGLVND=y
BR2_PACKAGE_MESA3D=y
# BR2_PACKAGE_MESA3D_LLVM is not set
BR2_PACKAGE_MESA3D_GALLIUM_DRIVER=y
BR2_PACKAGE_MESA3D_VULKAN_DRIVER=y
BR2_PACKAGE_MESA3D_DRIVER=y

BR2_PACKAGE_MESA3D_GALLIUM_DRIVER_SWRAST=y
# BR2_PACKAGE_MESA3D_GALLIUM_DRIVER_TEGRA is not set
# BR2_PACKAGE_MESA3D_GALLIUM_DRIVER_VIRGL is not set
BR2_PACKAGE_MESA3D_GALLIUM_DRIVER_ZINK=y
BR2_PACKAGE_MESA3D_GALLIUM_DRIVER_PVR=y
BR2_PACKAGE_MESA3D_VULKAN_DRIVER_POWERVR=y

#
# OpenGL API Support
#
BR2_PACKAGE_MESA3D_GBM=y

BR2_PACKAGE_MESA3D_OPENGL_EGL=y
BR2_PACKAGE_MESA3D_OPENGL_ES=y
BR2_PACKAGE_VULKAN_HEADERS=y
BR2_PACKAGE_VULKAN_LOADER=y


BR2_PACKAGE_LIBERATION=y
BR2_PACKAGE_WQY_ZENHEI=y
BR2_PACKAGE_WESTON=y
BR2_PACKAGE_XORG7=y
BR2_PACKAGE_XWAYLAND=y

BR2_PACKAGE_CRYPTSETUP=y
# BR2_PACKAGE_EUDEV_ENABLE_HWDB is not set
BR2_PACKAGE_GPTFDISK=y
BR2_PACKAGE_HWDATA=y
BR2_PACKAGE_HWDATA_PNP_IDS=y
BR2_PACKAGE_MDADM=y
BR2_PACKAGE_MEMTESTER=y
BR2_PACKAGE_SMARTMONTOOLS=y
BR2_PACKAGE_SYSSTAT=y
BR2_PACKAGE_LZ4=y
BR2_PACKAGE_ZLIB_NG=y
BR2_PACKAGE_LIBNSS=y
BR2_PACKAGE_LIBOPENSSL_BIN=y
BR2_PACKAGE_LIBOPENSSL_ENGINES=y
BR2_PACKAGE_CAIRO=y
BR2_PACKAGE_CAIRO_PNG=y
BR2_PACKAGE_LIBYAML=y
BR2_PACKAGE_LIBSOUP=y
BR2_PACKAGE_OPENMPI=y
BR2_PACKAGE_LIBEVDEV=y
BR2_PACKAGE_LIBICAL=y
BR2_PACKAGE_LIBPTHREAD_STUBS=y
BR2_PACKAGE_LIBURCU=y
BR2_PACKAGE_INIH=y
BR2_PACKAGE_PCRE2_16=y
BR2_PACKAGE_SLANG=y
BR2_PACKAGE_UTF8PROC=y
BR2_PACKAGE_HAVEGED=y
BR2_PACKAGE_DHCPCD=y
BR2_PACKAGE_ETHTOOL=y
BR2_PACKAGE_IPERF3=y
BR2_PACKAGE_IPROUTE2=y
BR2_PACKAGE_IPSET=y
BR2_PACKAGE_IPUTILS=y
BR2_PACKAGE_NTP=y
BR2_PACKAGE_OPENSSH=y
BR2_PACKAGE_RSYNC=y
BR2_PACKAGE_WHOIS=y
BR2_PACKAGE_WPA_SUPPLICANT=y
BR2_PACKAGE_WPA_SUPPLICANT_CLI=y
BR2_PACKAGE_BASH=y
BR2_PACKAGE_FILE=y
BR2_PACKAGE_ANDROID_TOOLS=y
BR2_PACKAGE_ANDROID_TOOLS_ADB=y
BR2_PACKAGE_ANDROID_TOOLS_ADBD=y
BR2_PACKAGE_FTOP=y
BR2_PACKAGE_GETENT=y
BR2_PACKAGE_HTOP=y
BR2_PACKAGE_KEYUTILS=y
BR2_PACKAGE_SEATD=y
BR2_PACKAGE_SEATD_BUILTIN=y
BR2_PACKAGE_SEATD_DAEMON=y
BR2_PACKAGE_TAR=y
BR2_PACKAGE_UTIL_LINUX_IRQTOP=y
BR2_PACKAGE_UTIL_LINUX_KILL=y
BR2_PACKAGE_UTIL_LINUX_MORE=y
BR2_PACKAGE_UTIL_LINUX_MOUNT=y
BR2_PACKAGE_VIM=y
# BR2_PACKAGE_VIM_RUNTIME is not set
BR2_TARGET_ROOTFS_CPIO=y
BR2_TARGET_ROOTFS_CPIO_DRACUT=y
BR2_TARGET_ROOTFS_CPIO_DRACUT_MODULES="$(BR2_EXTERNAL_Bianbu_PATH)/board/spacemit/k3/dracut-modules"
BR2_TARGET_ROOTFS_CPIO_DRACUT_CONF_FILES="$(BR2_EXTERNAL_Bianbu_PATH)/board/spacemit/k3/dracut.conf"
BR2_TARGET_ROOTFS_CPIO_GZIP=y
BR2_TARGET_ROOTFS_EXT2=y
BR2_TARGET_ROOTFS_EXT2_4=y
BR2_TARGET_ROOTFS_EXT2_SIZE="900M"
# BR2_TARGET_ROOTFS_TAR is not set
BR2_TARGET_OPENSBI=y
BR2_TARGET_OPENSBI_CUSTOM_VERSION=y
BR2_TARGET_OPENSBI_CUSTOM_VERSION_VALUE="0.9"
BR2_TARGET_OPENSBI_PLAT="generic"
# BR2_TARGET_OPENSBI_INSTALL_JUMP_IMG is not set
BR2_TARGET_OPENSBI_ADDITIONAL_VARIABLES="PLATFORM_DEFCONFIG=k3_defconfig"
BR2_TARGET_UBOOT=y
BR2_TARGET_UBOOT_BUILD_SYSTEM_KCONFIG=y
BR2_TARGET_UBOOT_CUSTOM_VERSION=y
BR2_TARGET_UBOOT_CUSTOM_VERSION_VALUE="2022.10"
BR2_TARGET_UBOOT_USE_CUSTOM_CONFIG=y
BR2_TARGET_UBOOT_CUSTOM_CONFIG_FILE="$(UBOOT_OVERRIDE_SRCDIR)/configs/k3_defconfig"
# BR2_TARGET_UBOOT_FORMAT_BIN is not set
BR2_TARGET_UBOOT_FORMAT_CUSTOM=y
BR2_TARGET_UBOOT_FORMAT_CUSTOM_NAME="u-boot.itb u-boot-env-default.bin"
BR2_TARGET_UBOOT_SPL=y
BR2_TARGET_UBOOT_SPL_NAME="FSBL.bin bootinfo_*.bin"
BR2_PACKAGE_HOST_CMAKE=y
BR2_PACKAGE_HOST_GENIMAGE=y
BR2_PACKAGE_HOST_JQ=y
BR2_PACKAGE_HOST_PYTHON_PYYAML=y
BR2_PACKAGE_HOST_PYTHON3=y
BR2_PACKAGE_HOST_QEMU=y
BR2_PACKAGE_HOST_UBOOT_TOOLS=y
BR2_PACKAGE_HOST_UBOOT_TOOLS_FIT_SUPPORT=y
BR2_PACKAGE_HOST_UBOOT_TOOLS_FIT_SIGNATURE_SUPPORT=y
BR2_PACKAGE_IMG_GPU_POWERVR=y

#
# X11 backend needs Xorg package
#
# BR2_PACKAGE_IMG_GPU_POWERVR_OUTPUT_FB is not set
BR2_PACKAGE_IMG_GPU_POWERVR_OUTPUT_WL=y
BR2_PACKAGE_GPU_TEST=y

BR2_PACKAGE_MPP=y
BR2_PACKAGE_K1X_VPU_TEST=y
BR2_PACKAGE_K1X_VPU_FIRMWARE=y
# BR2_PACKAGE_K1X_CAM is not set
# BR2_PACKAGE_JETSON_UTILS is not set
```

## fs/bootfs/Config.in
```kconfig
config BR2_TARGET_BOOTFS
	bool "boot filesystem"
	depends on BR2_LINUX_KERNEL && BR2_TARGET_ROOTFS_CPIO
	help
        Integrate the linux kernel image、initrd and some tools inside the boot partition image. 
        This integration will take place automatically.

if BR2_TARGET_BOOTFS

choice
    prompt "fs type"
    default BR2_TARGET_BOOTFS_TYPE_VFAT

config BR2_TARGET_BOOTFS_TYPE_VFAT
    bool "vfat"
    help
        Do image the boot partition with vfat.

config BR2_TARGET_BOOTFS_TYPE_EXT4
    bool "ext4"
    help
        Do image the boot partition with ext4.

endchoice

config BR2_TARGET_BOOTFS_LABEL
	string "filesystem label"
	default "bootfs"

endif #BR2_TARGET_BOOTFS
```

## package/aobench/Config.in
```kconfig
config BR2_PACKAGE_AOBENCH
	bool "aobench"

	help
	  aobench is a bench code for web

	  https://github.com/syoyo/aobench
```

## package/aom-av1-psy/Config.in
```kconfig
config BR2_PACKAGE_AOM_AV1_PSY
	bool "aom-av1-psy"
	help
	  aom-av1-psy encoding library.

	  https://github.com/BlueSwordM/aom-av1-psy
```

## package/blogbench/Config.in
```kconfig
config BR2_PACKAGE_BLOGBENCH
	bool "blogbench"
	help
      Blogbench is a portable filesystem benchmark that tries to reproduce the load
      of a real-word busy file server.

      https://github.com/jedisct1/Blogbench
```

## package/clomp/Config.in
```kconfig
config BR2_PACKAGE_CLOMP
	bool "clomp"
	help
	  CLOMP is the C version of the Livermore OpenMP benchmark developed to
		measure OpenMP overheads and other performance impacts due to threading
		in order to influence future system designs. 
		this version Without MP
	  https://github.com/sonjoyp/Clomp-Without-MP
```

## package/cray/Config.in
```kconfig
config BR2_PACKAGE_CRAY
	bool "cray"
	help
	
	  C-ray is a research oriented, hackable, offline CPU rendering engine built for learning. 

	  https://github.com/vkoskiv/c-ray
```

## package/csmith/Config.in
```kconfig
config BR2_PACKAGE_CSMITH
	bool "csmith"
	help
	  csmith is a random generator of C programs to test compiler bug.

	  http://github.com/csmith-project/csmith

comment "csmith "
```

## package/dcraw/Config.in
```kconfig
config BR2_PACKAGE_DCRAW
	bool "dcraw"
	select BR2_PACKAGE_JASPER
	select BR2_PACKAGE_JPEG
	select BR2_PACKAGE_LCMS2
	help
	  Modified to handle the JPEG+RAW files that can be generated 
	  by the Raspberry Pi camera modules, or just the raw file with Broadcom header 
	  passing data on raw format and resolution

	  https://github.com/6by9/dcraw
```

## package/esos/Config.in
```kconfig
config BR2_PACKAGE_ESOS
	bool "The ESOS(Energy Service OS) of Spacemit"
	help
	  ESOS is an energy efficiency management system developed by Spacemit.
```

## package/fhourstones88/Config.in
```kconfig
config BR2_PACKAGE_FHOURSTONES88
	bool "fhourstones88"
	help
	  This version of Fhourstones supports bitboards beyond 64-bits, 
	  as needed for the 8x8 size popular on littlegolem.net and itsyourturn.com.

	  https://github.com/tromp/fhourstones88

comment "fhourstones88"
```

## package/fsmark/Config.in
```kconfig
config BR2_PACKAGE_FSMARK
	bool "fsmark"
	help
	  The fs_mark program is meant to give a low level bashing to file
		systems.

	  https://github.com/josefbacik/fs_mark
```

## package/gpu-test/Config.in
```kconfig
config BR2_PACKAGE_GPU_TEST
	bool "gpu-test"
	default n
	depends on BR2_PACKAGE_HAS_LIBEGL
	depends on BR2_PACKAGE_HAS_LIBGLES
	depends on BR2_PACKAGE_WAYLAND && BR2_PACKAGE_WESTON
	help
	  Spacemit k1x gpu driver test.
```
